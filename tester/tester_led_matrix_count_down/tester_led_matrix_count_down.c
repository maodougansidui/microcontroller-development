#include <reg52.h>

sbit ADDR0=P1^0;
sbit ADDR1=P1^1;
sbit ADDR2=P1^2;
sbit ADDR3=P1^3;
sbit ENLED=P1^4;

unsigned char code LedMatrix[10][8]={
	{0x81,0xBD,0xBD,0x81,0xBF,0xBF,0xBF,0x81},		// 9
	{0xC3,0xDB,0xDB,0xC3,0xE7,0xDB,0xDB,0xC3},		// 8
	{0x81,0x9F,0x9F,0xCF,0xE7,0xF3,0xF9,0xF9},		// 7
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	{0xC3,0x99,0xBD,0xBD,0xBD,0xBD,0x99,0xC3}		// 0
};

void main(){
	EA=1;
	ADDR3=0;
	ENLED=0;

	TMOD=0x01;
	TH0=0xFC;
	TL0=0x67;
	ET0=1;
	TR0=1;
	while(1);
}

void InterruptTimer0() interrupt 1{
	static unsigned char i=0;
	static unsigned char index=0;
	static unsigned int tmr=0;

	TH0=0xFC;
	TL0=0x67;

	P0=0xFF;
	switch(i){
		case 0: ADDR2=0;ADDR1=0;ADDR0=0;i++;P0=LedMatrix[index][0];break;
		case 1: ADDR2=0;ADDR1=0;ADDR0=1;i++;P0=LedMatrix[index][1];break;
		case 2: ADDR2=0;ADDR1=1;ADDR0=0;i++;P0=LedMatrix[index][2];break;
		case 3: ADDR2=0;ADDR1=1;ADDR0=1;i++;P0=LedMatrix[index][3];break;
		case 4: ADDR2=1;ADDR1=0;ADDR0=0;i++;P0=LedMatrix[index][4];break;
		case 5: ADDR2=1;ADDR1=0;ADDR0=1;i++;P0=LedMatrix[index][5];break;
		case 6: ADDR2=1;ADDR1=1;ADDR0=0;i++;P0=LedMatrix[index][6];break;
		case 7: ADDR2=1;ADDR1=1;ADDR0=1;i=0;P0=LedMatrix[index][7];break;
		default:break;
	}
	tmr++;
	if (tmr==1000){
		tmr=0;
		index++;
		if(index>9){
			index=0;
		}
	}

}